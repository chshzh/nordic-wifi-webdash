## src/modules/memory/Kconfig.memory
```kconfig
menu "Memory diagnostics"

config APP_HEAP_MONITOR
	bool "Enable runtime heap monitor"
	default n
	select SYS_HEAP_RUNTIME_STATS
	select SYS_HEAP_LISTENER
	help
	  Enable runtime monitoring of the system heap (_system_heap) to track
	  memory usage and log high-water marks during operation. This module
	  registers a heap listener that reports peak allocation whenever usage
	  increases by CONFIG_APP_HEAP_MONITOR_STEP_BYTES or exceeds the warning
	  threshold. Useful for sizing heap requirements during development.
	  The monitor also emits a boot-time report showing initial heap state.
	  Disable this option in production if the listener overhead or log
	  volume is not acceptable.

config APP_HEAP_MONITOR_WARN_PCT
	int "Warn threshold for heap high-water mark"
	default 88
	range 50 99
	depends on APP_HEAP_MONITOR
	help
	  Emit a warning when the tracked heap max crosses this percentage of the
	  total heap size.

config APP_HEAP_MONITOR_STEP_BYTES
	int "Minimum increase before logging a new high-water mark"
	default 4096
	range 256 65536
	depends on APP_HEAP_MONITOR
	help
	  Prevent log spam by only reporting new peaks after this many additional
	  bytes have been allocated since the last report.

endmenu
```

## src/modules/mode_selector/Kconfig.mode_selector
```kconfig
#
# Copyright (c) 2026 Nordic Semiconductor ASA
#
# SPDX-License-Identifier: LicenseRef-Nordic-5-Clause
#

config APP_MODE_SELECTOR
	bool "Enable Wi-Fi mode selector"
	default y
	select SETTINGS
	select FLASH
	select FLASH_MAP
	select FLASH_PAGE_LAYOUT
	help
	  Reads the persisted Wi-Fi mode from NVS on every boot and publishes
	  it on WIFI_MODE_CHAN before the Wi-Fi module starts.  The
	  `wifi_mode [SoftAP|STA|P2P]` shell command can be used at any time to change
	  the active mode; the board reboots automatically to apply the change.

if APP_MODE_SELECTOR

module = MODE_SELECTOR
module-str = mode_selector
source "subsys/logging/Kconfig.template.log_config"

endif # APP_MODE_SELECTOR
```

## src/modules/network/Kconfig.network
```kconfig
#
# Copyright (c) 2026 Nordic Semiconductor ASA
#
# SPDX-License-Identifier: LicenseRef-Nordic-5-Clause
#

config NETWORK_MODULE
	bool "Unified network / Wi-Fi event management module"
	default y
	help
	  Enable the combined network and Wi-Fi module.  Handles interface
	  UP/DOWN events, WPA supplicant ready sequencing, SoftAP bring-up,
	  DHCP server, STA/P2P DHCP binding, and Zbus event publishing for
	  all three Wi-Fi modes (SoftAP, STA, P2P).

# ---------------------------------------------------------------------------
# SoftAP configuration (formerly in wifi/Kconfig.wifi)
# ---------------------------------------------------------------------------

menu "SoftAP Configuration"

config APP_SOFTAP_REG_DOMAIN
	string "SoftAP regulatory domain"
	default "US"
	help
	  Two-letter country code for the regulatory domain used in SoftAP
	  mode (e.g. "US", "EU", "JP"). Use "00" for world/permissive mode.

choice APP_SOFTAP_BAND
	prompt "SoftAP Wi-Fi band"
	default APP_SOFTAP_BAND_2_4_GHZ
	help
	  Wi-Fi frequency band to use when hosting SoftAP.

config APP_SOFTAP_BAND_2_4_GHZ
	bool "2.4 GHz"

config APP_SOFTAP_BAND_5_GHZ
	bool "5 GHz"

endchoice # APP_SOFTAP_BAND

config APP_SOFTAP_CHANNEL
	int "SoftAP channel"
	default 1
	range 1 196
	help
	  Wi-Fi channel number for SoftAP. Must be valid for the selected
	  band and regulatory domain (e.g. 1-13 for 2.4 GHz; 36, 40, 44…
	  for 5 GHz). Defaults to channel 1 (2.4 GHz).

endmenu # "SoftAP Configuration"

# ---------------------------------------------------------------------------
# Log level (standard Zephyr template)
# ---------------------------------------------------------------------------

module = NETWORK_MODULE
module-str = network_module
source "subsys/logging/Kconfig.template.log_config"
```

## src/modules/wifi/Kconfig.wifi
```kconfig
#
# Copyright (c) 2026 Nordic Semiconductor ASA
#
# SPDX-License-Identifier: LicenseRef-Nordic-5-Clause
#

config APP_WIFI_MODULE
	bool "Enable WiFi module (SoftAP / STA / P2P)"
	default y
	help
	  Enable the multi-mode WiFi module. The active mode is selected at
	  boot by the mode_selector module.  All three modes (SoftAP, STA,
	  P2P) are supported on both nRF7002DK and nRF54LM20DK when the
	  firmware is built with the -S wifi-p2p snippet.

menu "SoftAP Configuration"

config APP_SOFTAP_REG_DOMAIN
	string "SoftAP regulatory domain"
	default "US"
	help
	  Two-letter country code for regulatory domain used in SoftAP mode
	  (e.g. "US", "EU", "JP"). Use "00" for world/permissive mode.

choice APP_SOFTAP_BAND
	prompt "SoftAP Wi-Fi band"
	default APP_SOFTAP_BAND_2_4_GHZ
	help
	  Wi-Fi frequency band to use when hosting SoftAP.

config APP_SOFTAP_BAND_2_4_GHZ
	bool "2.4 GHz"
	help
	  Use 2.4 GHz band (channels 1-14, regulatory domain dependent).

config APP_SOFTAP_BAND_5_GHZ
	bool "5 GHz"
	help
	  Use 5 GHz band (channels 36-196, regulatory domain dependent).

endchoice # APP_SOFTAP_BAND

config APP_SOFTAP_CHANNEL
	int "SoftAP channel"
	default 1
	range 1 196
	help
	  Wi-Fi channel number for SoftAP. Must be valid for the selected
	  band and regulatory domain (e.g. 1-13 for 2.4 GHz; 36, 40, 44...
	  for 5 GHz). Defaults to channel 1 (2.4 GHz).

endmenu # "SoftAP Configuration"

module = WIFI_MODULE
module-str = wifi_module
source "subsys/logging/Kconfig.template.log_config"
```
