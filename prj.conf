## CMakeLists.txt
```
#
# Copyright (c) 2026 Nordic Semiconductor ASA
#
# SPDX-License-Identifier: LicenseRef-Nordic-5-Clause
#

cmake_minimum_required(VERSION 3.20.0)

# Register zego modules: button, led, wifi, network, wifi_ble_prov, memonitor, factory_reset.
get_filename_component(ZEGO_BUTTON_DIR ${CMAKE_CURRENT_SOURCE_DIR}/../zego/bricks/button REALPATH)
get_filename_component(ZEGO_LED_DIR ${CMAKE_CURRENT_SOURCE_DIR}/../zego/bricks/led REALPATH)
get_filename_component(ZEGO_WIFI_DIR ${CMAKE_CURRENT_SOURCE_DIR}/../zego/bricks/wifi REALPATH)
get_filename_component(ZEGO_NETWORK_DIR ${CMAKE_CURRENT_SOURCE_DIR}/../zego/bricks/network REALPATH)
get_filename_component(ZEGO_WIFI_BLE_PROV_DIR ${CMAKE_CURRENT_SOURCE_DIR}/../zego/bricks/wifi_ble_prov REALPATH)
get_filename_component(ZEGO_MEMONITOR_DIR ${CMAKE_CURRENT_SOURCE_DIR}/../zego/bricks/memonitor REALPATH)
get_filename_component(ZEGO_UX_DIR ${CMAKE_CURRENT_SOURCE_DIR}/../zego/bricks/ux REALPATH)
get_filename_component(ZEGO_FACTORY_RESET_DIR ${CMAKE_CURRENT_SOURCE_DIR}/../zego/bricks/factory_reset REALPATH)
list(APPEND EXTRA_ZEPHYR_MODULES ${ZEGO_BUTTON_DIR} ${ZEGO_LED_DIR} ${ZEGO_WIFI_DIR} ${ZEGO_NETWORK_DIR} ${ZEGO_WIFI_BLE_PROV_DIR} ${ZEGO_MEMONITOR_DIR} ${ZEGO_UX_DIR} ${ZEGO_FACTORY_RESET_DIR})

find_package(Zephyr REQUIRED HINTS $ENV{ZEPHYR_BASE})
project(nordic_wifi_webdash)

target_include_directories(app PUBLIC ${ZEPHYR_BASE}/subsys/net/ip)

# HTTP linker sections and static web assets — only needed when HTTP server is enabled
if(CONFIG_HTTP_SERVER)
  zephyr_linker_sources(SECTIONS sections-rom.ld)
  zephyr_linker_section_ifdef(CONFIG_HTTP_SERVER NAME
                  http_resource_desc_webserver_service
                  KVMA RAM_REGION GROUP RODATA_REGION
                  SUBALIGN Z_LINK_ITERABLE_SUBALIGN)
  set(gen_dir ${ZEPHYR_BINARY_DIR}/include/generated/)
  foreach(web_resource index.html main.js styles.css)
    generate_inc_file_for_target(app src/modules/webserver/www/${web_resource}
      ${gen_dir}/${web_resource}.gz.inc --gzip)
  endforeach()
endif()

# Add subdirectories for modules
# mode_selector now provided by zego/wifi (EXTRA_ZEPHYR_MODULES above)
# Shared network module provided by zego/network (EXTRA_ZEPHYR_MODULES above);
# app shim (net_event_app.c) defines CLIENT_CONNECTED_CHAN and overrides weak callbacks.
add_subdirectory(src/modules/network)
# button and led now provided by zego/button and zego/led (EXTRA_ZEPHYR_MODULES above)
add_subdirectory(src/modules/webserver)
# memonitor now provided by zego/bricks/memonitor (EXTRA_ZEPHYR_MODULES above)

# APP_VERSION_STRING, PRD_VERSION, SPECS_VERSION set by zego/wifi/CMakeLists.txt
target_sources(app PRIVATE src/main.c)
```

## Kconfig
```
#
# Copyright (c) 2026 Nordic Semiconductor ASA
#
# SPDX-License-Identifier: LicenseRef-Nordic-5-Clause
#

menu "Nordic Wi-Fi WebDash"

config APP_WIFI_SSID
	string "Wi-Fi SoftAP SSID"
	default "WebDash_AP"
	help
	  SSID of the Wi-Fi SoftAP to create. Override this value in
	  overlay-wifi-credentials.conf (listed in .gitignore) to avoid committing
	  production credentials.

config APP_WIFI_PASSWORD
	string "Wi-Fi SoftAP Password"
	default "12345678"
	help
	  Password for Wi-Fi SoftAP (min 8 characters for WPA2). Provide real
	  credentials via the local overlay-wifi-credentials.conf to keep secrets
	  out of version control.

config APP_HTTP_PORT
	int "HTTP Server Port"
	default 80
	help
	  HTTP server port number

# mode_selector and network Kconfig now provided by zego/wifi_app_main and
# zego/network (EXTRA_ZEPHYR_MODULES) — no rsource needed here.
# button and led Kconfig registered via EXTRA_ZEPHYR_MODULES (zego/button, zego/led)
rsource "src/modules/webserver/Kconfig.webserver"
# memonitor Kconfig now provided by zego/bricks/memonitor (EXTRA_ZEPHYR_MODULES)

endmenu

source "Kconfig.zephyr"
```

## sysbuild.conf
```
#
# Copyright (c) 2026 Nordic Semiconductor ASA
#
# SPDX-License-Identifier: LicenseRef-Nordic-5-Clause
#

# Wi-Fi support
SB_CONFIG_WIFI_NRF70=y
# Partition manage deprecated after NCS v3.3.0
SB_CONFIG_PARTITION_MANAGER=n
SB_CONFIG_MERGED_HEX_FILES=y

# nRF5340 (nrf7002dk) only: the BLE controller runs on the network core
# over IPC. Build the upstream Zephyr hci_ipc sample as the netcore image
# so the Wi-Fi provisioning over BLE module can open the HCI driver.
# On nrf54lm20dk SUPPORT_NETCORE=n (single-core SoC), so this setting
# has no effect there.
SB_CONFIG_NETCORE_HCI_IPC=y
```

## west.yml
```
manifest:
  version: "0.13"

  defaults:
    remote: ncs

  remotes:
    - name: ncs
      url-base: https://github.com/nrfconnect
    - name: chshzh
      url-base: https://github.com/chshzh

  projects:
    # NCS v3.4.0 — imports zephyr, bootloader, modules, nrfxlib, tools, etc.
    - name: sdk-nrf
      path: nrf
      revision: v3.4.0
      import: true
      remote: ncs
      
    # Common app modules and libraries
    - name: zego
      path: zego
      revision: v3.4.0.3
      remote: chshzh

    # Add more sibling projects as needed:
    # - name: nordic-wifi-memfault
    #   path: nordic-wifi-memfault
    #   revision: main
    #   remote: chshzh

    # - name: nordic-wifi-audio
    #   path: nordic-wifi-audio
    #   revision: main
    #   remote: chshzh

    # - name: claude
    #   path: .claude
    #   revision: main
    #   remote: chshzh

    - name: zview
      url: https://github.com/chshzh/zview
      revision: main
      path: modules/tools/zview
      west-commands: scripts/west-commands.yml
    
  self:
    path: nordic-wifi-webdash
```

## prj.conf
```kconfig
#
# Copyright (c) 2026 Nordic Semiconductor ASA
#
# SPDX-License-Identifier: LicenseRef-Nordic-5-Clause
#

# Configuration coverage priority:
# Command line > Overlay files > project boards/<board>.conf > prj.conf > Board defconfig
# (highest)                                                              (lowest)


# This file contains only:
#   - System-level configuration that belongs to no single module
#   - Module enable/disable flags
#   - Log-level choices (cannot be set via Kconfig.defaults)
#   - Project-specific overrides that differ from module defaults
#   - Shared cross-module settings (TLS, mbedTLS)
#   - Hardware-specific memory and stack tuning
# Module-specific defaults live in each module's Kconfig.defaults file.

# =========================================================================
# Wi-Fi Configuration (SoftAP + STA; P2P requires -Dnordic-wifi-webdash_SNIPPET=wifi-p2p)
# =========================================================================
CONFIG_WIFI=y
CONFIG_WIFI_NRF70=y

# WPA supplicant — supports both STA and SoftAP in the same binary
CONFIG_WIFI_NM_WPA_SUPPLICANT=y
CONFIG_WIFI_NM_WPA_SUPPLICANT_AP=y
CONFIG_WIFI_NM_WPA_SUPPLICANT_THREAD_STACK_SIZE=8192
CONFIG_WIFI_NM_WPA_SUPPLICANT_WQ_STACK_SIZE=5632

# nRF70 SoftAP mode
CONFIG_NRF70_AP_MODE=y
CONFIG_NRF_WIFI_LOW_POWER=n

# =========================================================================
# Shell — required for mode selector UX and wifi_cred STA setup
# =========================================================================
CONFIG_SHELL=y
CONFIG_NET_L2_WIFI_SHELL=y
# CONFIG_NET_SHELL=y # Consumes big memory
CONFIG_WIFI_SHELL_MAX_AP_STA=2
CONFIG_SHELL_STACK_SIZE=8192

# =========================================================================
# Networking
# =========================================================================
CONFIG_NETWORKING=y
CONFIG_NET_SOCKETS=y
CONFIG_NET_IPV4=y
CONFIG_NET_UDP=y
CONFIG_NET_TCP=y
CONFIG_NET_IPV6=n

# DHCP Server (SoftAP)
CONFIG_NET_DHCPV4=y
CONFIG_NET_DHCPV4_SERVER=y
CONFIG_NET_DHCPV4_SERVER_ADDR_COUNT=2

# Static IP for SoftAP gateway
CONFIG_NET_CONFIG_SETTINGS=y
CONFIG_NET_CONFIG_MY_IPV4_ADDR="192.168.7.1"
CONFIG_NET_CONFIG_MY_IPV4_NETMASK="255.255.255.0"
CONFIG_NET_CONFIG_MY_IPV4_GW="192.168.7.1"
CONFIG_NET_CONFIG_INIT_TIMEOUT=0

# =========================================================================
# STA mode — Connection Manager + Wi-Fi Credentials
# =========================================================================
CONFIG_NET_CONNECTION_MANAGER=y
CONFIG_NET_CONNECTION_MANAGER_MONITOR_STACK_SIZE=5120
CONFIG_L2_WIFI_CONNECTIVITY=y
CONFIG_L2_WIFI_CONNECTIVITY_AUTO_CONNECT=n
CONFIG_L2_WIFI_CONNECTIVITY_AUTO_DOWN=n

CONFIG_WIFI_CREDENTIALS=y
CONFIG_WIFI_CREDENTIALS_BACKEND_SETTINGS=y
CONFIG_DNS_RESOLVER=y
CONFIG_DNS_RESOLVER_AUTO_INIT=y

# =========================================================================
# Mode Selector — NVS persistence (Flash / Settings / NVS)
# =========================================================================
CONFIG_SETTINGS=y
CONFIG_SETTINGS_NVS=y
CONFIG_NVS=y
CONFIG_FLASH=y
CONFIG_FLASH_MAP=y
CONFIG_FLASH_PAGE_LAYOUT=y

# =========================================================================
# Network buffers — tuned for performance
# =========================================================================
CONFIG_NET_PKT_RX_COUNT=16
CONFIG_NET_PKT_TX_COUNT=24
CONFIG_NET_BUF_RX_COUNT=16
CONFIG_NET_BUF_TX_COUNT=32
CONFIG_NRF70_RX_NUM_BUFS=16
CONFIG_NET_TC_TX_COUNT=1
CONFIG_NET_IF_UNICAST_IPV4_ADDR_COUNT=1
CONFIG_NET_MAX_CONTEXTS=16
CONFIG_NET_MAX_CONN=16
CONFIG_NET_CONTEXT_SYNC_RECV=y
CONFIG_NET_CONTEXT_RCVTIMEO=y
CONFIG_NET_L2_ETHERNET=y
CONFIG_NET_SOCKETS_POLL_MAX=10

# =========================================================================
# HTTP Server
# =========================================================================
CONFIG_HTTP_PARSER_URL=y
CONFIG_HTTP_PARSER=y
CONFIG_HTTP_SERVER=y
CONFIG_HTTP_SERVER_MAX_CLIENTS=10
CONFIG_HTTP_SERVER_MAX_STREAMS=10

# =========================================================================
# mDNS / DNS-SD — enables http://nrfwebdash.local
# =========================================================================
CONFIG_MDNS_RESPONDER=y
CONFIG_DNS_SD=y
CONFIG_MDNS_RESPONDER_DNS_SD=y

CONFIG_NET_HOSTNAME_ENABLE=y
CONFIG_NET_HOSTNAME_UNIQUE=n
CONFIG_NET_HOSTNAME="nrfwebdash"

# =========================================================================
# SMF + Zbus
# =========================================================================
CONFIG_SMF=y
CONFIG_SMF_INITIAL_TRANSITION=y
CONFIG_SMF_ANCESTOR_SUPPORT=y
CONFIG_ZBUS=y
CONFIG_ZBUS_PRIORITY_BOOST=y
CONFIG_ZBUS_RUNTIME_OBSERVERS=y
CONFIG_ZBUS_MSG_SUBSCRIBER=y

# =========================================================================
# GPIO / DK Library
# =========================================================================
CONFIG_GPIO=y
CONFIG_DK_LIBRARY=y

# =========================================================================
# JSON
# =========================================================================
CONFIG_JSON_LIBRARY=y

# =========================================================================
# Memory / Stack sizes (sized from thread analyzer high-water marks)
# =========================================================================
CONFIG_MAIN_STACK_SIZE=8192
CONFIG_NET_RX_STACK_SIZE=2048
CONFIG_NET_TX_STACK_SIZE=2048
CONFIG_SYSTEM_WORKQUEUE_STACK_SIZE=2048
# With CONN_MGR_IF_NO_AUTO_CONNECT cleared for P2P, the RPU context stays
# alive after a P2P group failure.  The WPA supplicant then does a full
# interface_remove cleanup which runs in the net_mgmt event thread.
# 2048 bytes overflows; 4096 is sufficient for the WPA supplicant cleanup.
CONFIG_NET_MGMT_EVENT_STACK_SIZE=4096
CONFIG_HTTP_SERVER_STACK_SIZE=4096
CONFIG_NET_SOCKETS_SERVICE_STACK_SIZE=3072

# =========================================================================
# System
# =========================================================================
CONFIG_REBOOT=y

# =========================================================================
# Debugging
# =========================================================================
# CONFIG_STACK_SENTINEL must be =n: it overwrites the 0xaa init-fill with
# 0xf0f0f0f0, which causes k_thread_stack_space_get() and ZView to report
# 100% stack usage on every thread even when stacks are mostly unused.
CONFIG_STACK_SENTINEL=n
CONFIG_DEBUG_COREDUMP=y
CONFIG_DEBUG_COREDUMP_BACKEND_LOGGING=y
CONFIG_DEBUG_COREDUMP_MEMORY_DUMP_MIN=y
CONFIG_SHELL_CMDS_RESIZE=n

# =========================================================================
# Kernel options
# =========================================================================
CONFIG_ENTROPY_GENERATOR=y
CONFIG_INIT_STACKS=y

# =========================================================================
# Eventfd — WPA supplicant needs more than 2
# =========================================================================
CONFIG_EVENTFD=y
CONFIG_ZVFS_OPEN_MAX=48
CONFIG_ZVFS_EVENTFD_MAX=16
CONFIG_POSIX_API=y
#CONFIG_FDTABLE=y

# =========================================================================
# Module log levels
# =========================================================================
CONFIG_ZEGO_WIFI=y
CONFIG_ZEGO_WIFI_DEFAULT_MODE_STA=y
CONFIG_ZEGO_WIFI_LOG_LEVEL_INF=y

CONFIG_ZEGO_WIIF_SOFTAP_SSID="WebDash_AP"
CONFIG_ZEGO_WIIF_SOFTAP_PASSWORD="12345678"
# BLE Wi-Fi provisioning (zego/wifi_ble_prov module)
CONFIG_ZEGO_WIFI_BLE_PROV=y
CONFIG_ZEGO_NETWORK=y
CONFIG_ZEGO_NETWORK_LOG_LEVEL_INF=y
CONFIG_ZEGO_BUTTON=y
CONFIG_ZEGO_BUTTON_LOG_LEVEL_INF=y
# Enable the button brick's 2nd hold tier (BUTTON_LONGER_PRESS) so the Wi-Fi
# control button (CONFIG_ZEGO_UX_BUTTON_IDX, default idx 0) serves both
# gestures: 3 s hold = Wi-Fi mode cycle (zego/ux's guarded BUTTON_LONG_PRESS,
# unchanged), 10 s hold = factory reset (zego/factory_reset). The 3 s action
# is deferred to release instead of firing at 3 s, so a hold continuing to
# 10 s supersedes it — see zego/bricks/button/docs/button-spec.md "Two-Tier
# Hold Gesture".
CONFIG_ZEGO_BUTTON_LONGER_PRESS_MS=10000
CONFIG_ZEGO_LED=y
CONFIG_ZEGO_LED_LOG_LEVEL_INF=y
CONFIG_WEBSERVER_MODULE_LOG_LEVEL_INF=y

# Factory reset (zego/factory_reset): erases Wi-Fi credentials + saved Wi-Fi
# mode + P2P GO MAC, then reboots. Triggered by the 10 s button hold above
# and/or the 'zego_factory_reset' shell command (FR-109).
CONFIG_ZEGO_FACTORY_RESET=y
CONFIG_ZEGO_FACTORY_RESET_LOG_LEVEL_INF=y

# =========================================================================
# Heap tuning
# WPA supplicant and POSIX subsystems add ~46 KB via HEAP_MEM_POOL_ADD_SIZE_*.
# Keep the base heap at 80 KB so total managed heap is around 125 KB.
# =========================================================================
CONFIG_HEAP_MEM_POOL_SIZE=90000
CONFIG_HEAP_MEM_POOL_IGNORE_MIN=n
CONFIG_NRF_WIFI_GLOBAL_HEAP=n

# =========================================================================
# Logging Configuration
# =========================================================================
CONFIG_LOG=y
CONFIG_LOG_BUFFER_SIZE=4096
# Deferred mode: log messages are queued and processed in the logging thread,
# not inline in the calling thread (net_mgmt event thread, etc.)
CONFIG_LOG_MODE_DEFERRED=y
# NET_LOG=y is required for any NET_*_LOG_LEVEL_* choice to become visible
# (all net module log choices depend on NET_LOG).
# All modules explicitly silenced to avoid FLASH overflow; only NET_SOCKETS at DBG.
CONFIG_WIFI_NRF70_BUSLIB_LOG_LEVEL_WRN=y
CONFIG_NVS_LOG_LEVEL_WRN=y
CONFIG_WIFI_NM_WPA_SUPPLICANT_LOG_LEVEL_WRN=y
# WEP and WPA1/TKIP (LEGACY_CRYPTO) are both cryptographically broken (WEP:
# full key recovery in minutes via aircrack-ng-class attacks; TKIP: Beck-Tews/
# Ohigashi-Morii partial plaintext recovery) and have been out of Wi-Fi
# Alliance certification since 2004 / 2012 respectively. WPA2-AES/CCMP has
# been mandatory in every certified AP since 2006, so the compatibility cost
# of dropping both is negligible. This app only uses personal WPA2/WPA3-PSK
# (no enterprise/EAP), which doesn't touch either symbol. Matches the same
# decision applied in nordic-wifi-memfault/prj.conf and
# zego/nordic-wifi-app-template/prj.conf.
CONFIG_WIFI_NM_WPA_SUPPLICANT_WEP=n
CONFIG_WIFI_NM_WPA_SUPPLICANT_LEGACY_CRYPTO=n
CONFIG_NET_LOG=n
# CONFIG_NET_IPV4_LOG_LEVEL_DBG=y
# CONFIG_MDNS_RESPONDER_LOG_LEVEL_DBG=y
# CONFIG_NET_SOCKETS_LOG_LEVEL_INF=y
# CONFIG_MQTT_LOG_LEVEL_DBG=y
# CONFIG_MQTT_HELPER_LOG_LEVEL_DBG=y
# CONFIG_SOCKS_LOG_LEVEL_OFF=y
# CONFIG_TLS_CREDENTIALS_LOG_LEVEL_OFF=y
# CONFIG_DNS_RESOLVER_LOG_LEVEL_OFF=y
# CONFIG_DNS_SD_LOG_LEVEL_OFF=y
# CONFIG_DNS_SOCKET_DISPATCHER_LOG_LEVEL_OFF=y
# CONFIG_LATMON_LOG_LEVEL_OFF=y
# CONFIG_LLMNR_RESPONDER_LOG_LEVEL_OFF=y
# CONFIG_LWM2M_LOG_LEVEL_OFF=y
# CONFIG_MDNS_RESPONDER_LOG_LEVEL_OFF=y
# CONFIG_NET_6LO_LOG_LEVEL_OFF=y
# CONFIG_NET_ARP_LOG_LEVEL_OFF=y
# CONFIG_NET_CAPTURE_LOG_LEVEL_OFF=y
# CONFIG_NET_CONFIG_LOG_LEVEL_OFF=y
# CONFIG_NET_CONN_LOG_LEVEL_OFF=y
# CONFIG_NET_CONNECTION_MANAGER_LOG_LEVEL_OFF=y
# CONFIG_NET_CONTEXT_LOG_LEVEL_OFF=y
# CONFIG_NET_CORE_LOG_LEVEL_OFF=y
# CONFIG_NET_DHCPV4_LOG_LEVEL_OFF=y
# CONFIG_NET_DHCPV4_SERVER_LOG_LEVEL_OFF=y
# CONFIG_NET_DHCPV6_LOG_LEVEL_OFF=y
# CONFIG_NET_DSA_LOG_LEVEL_OFF=y
# CONFIG_NET_ETHERNET_BRIDGE_LOG_LEVEL_OFF=y
# CONFIG_NET_GPTP_LOG_LEVEL_OFF=y
# CONFIG_NET_HTTP_SERVER_LOG_LEVEL_OFF=y
# CONFIG_NET_ICMPV4_LOG_LEVEL_OFF=y
# CONFIG_NET_ICMPV6_LOG_LEVEL_OFF=y
# CONFIG_NET_IF_LOG_LEVEL_OFF=y
# CONFIG_NET_IPV4_LOG_LEVEL_OFF=y
# CONFIG_NET_IPV4_ACD_LOG_LEVEL_OFF=y
# CONFIG_NET_IPV4_AUTO_LOG_LEVEL_OFF=y
# CONFIG_NET_IPV6_LOG_LEVEL_OFF=y
# CONFIG_NET_IPV6_NBR_CACHE_LOG_LEVEL_OFF=y
# CONFIG_NET_IPV6_ND_LOG_LEVEL_OFF=y
# CONFIG_NET_IPV6_PE_LOG_LEVEL_OFF=y
# CONFIG_NET_L2_ETHERNET_LOG_LEVEL_OFF=y
# CONFIG_NET_L2_IEEE802154_LOG_LEVEL_OFF=y
# CONFIG_NET_L2_IPIP_LOG_LEVEL_OFF=y
# CONFIG_NET_L2_PPP_LOG_LEVEL_OFF=y
# CONFIG_NET_L2_VIRTUAL_LOG_LEVEL_OFF=y
# CONFIG_NET_L2_WIFI_MGMT_LOG_LEVEL_OFF=y
# CONFIG_NET_LLDP_LOG_LEVEL_OFF=y
# CONFIG_NET_MGMT_EVENT_LOG_LEVEL_OFF=y
# CONFIG_NET_OFFLOAD_LOG_LEVEL_OFF=y
# CONFIG_NET_PKT_FILTER_LOG_LEVEL_OFF=y
# CONFIG_NET_PMTU_LOG_LEVEL_OFF=y
# CONFIG_NET_PROMISC_LOG_LEVEL_OFF=y
# CONFIG_NET_PSEUDO_IFACE_LOG_LEVEL_OFF=y
# CONFIG_NET_ROUTE_LOG_LEVEL_OFF=y
# CONFIG_NET_STATISTICS_LOG_LEVEL_OFF=y
# CONFIG_NET_TC_LOG_LEVEL_OFF=y
# CONFIG_NET_TCP_LOG_LEVEL_OFF=y
# CONFIG_NET_TRICKLE_LOG_LEVEL_OFF=y
# CONFIG_NET_UDP_LOG_LEVEL_OFF=y
# CONFIG_NET_UTILS_LOG_LEVEL_OFF=y
# CONFIG_NET_WEBSOCKET_LOG_LEVEL_OFF=y
# CONFIG_NET_ZPERF_LOG_LEVEL_OFF=y
# CONFIG_OPENTHREAD_L2_LOG_LEVEL_OFF=y
# CONFIG_PROMETHEUS_LOG_LEVEL_OFF=y
# CONFIG_PTP_LOG_LEVEL_OFF=y
# CONFIG_SNTP_LOG_LEVEL_OFF=y
# CONFIG_WIFI_CREDENTIALS_LOG_LEVEL_OFF=y
# CONFIG_WIFI_NM_LOG_LEVEL_OFF=y

# =========================================================================
# Debug & Optimization
# =========================================================================
# C Library
CONFIG_PICOLIBC=y
CONFIG_MINIMAL_LIBC=n
CONFIG_NEWLIB_LIBC=n

# Thread analysis (for debugging)
# CONFIG_THREAD_ANALYZER=y
# CONFIG_DEBUG_THREAD_INFO=y
# CONFIG_THREAD_ANALYZER_USE_LOG=y
# CONFIG_THREAD_ANALYZER_AUTO=y
# CONFIG_THREAD_ANALYZER_AUTO_INTERVAL=60

# Heap monitoring
#CONFIG_HEAPS_MONITOR=y

# =========================================================================
# (ZView config block moved to the Thread + heap runtime stats section below)

# =========================================================================
# UX module — Button 0 gestures + LED 0 Wi-Fi state machine (FR-106)
# Provided by zego/bricks/ux (moved here from a local module during the
# v3.4.0 migration — see net_event_app.c for the ZEGO_UX_WIFI_STATE_CHAN wiring).
# =========================================================================
CONFIG_ZEGO_UX=y

# =========================================================================
# memonitor — periodic heap + thread sampler, /api/heaps, /api/threads (FR-107/108)
# Set =n to disable: the Thread Monitor and Heap Monitor sections will be
# hidden automatically on the webpage.
# =========================================================================
CONFIG_ZEGO_MEMONITOR=y
CONFIG_ZEGO_MEMONITOR_INTERVAL_MS=5000
# ZEGO_MEMONITOR_ZVIEW selects all required Kconfig symbols:
#   INIT_STACKS, THREAD_MONITOR, THREAD_STACK_INFO, THREAD_NAME,
#   THREAD_RUNTIME_STATS, SYS_HEAP_RUNTIME_STATS.
# CONFIG_STACK_SENTINEL=n is mandatory: it overwrites the 0xaa init-fill with
# 0xf0f0f0f0, causing ZView to report 100% stack usage on every thread.
CONFIG_ZEGO_MEMONITOR_ZVIEW=y
CONFIG_STACK_SENTINEL=n

# =========================================================================
# Document versions — keep in sync with docs/pm-prd/PRD.md and
# docs/dev-specs/overview.md Changelog timestamps.
# =========================================================================
CONFIG_APP_PRD_VERSION="2026-08-04-10-29"
CONFIG_APP_SPECS_VERSION="2026-08-04-10-30"
```

## overlay-sta-no-webserver.conf
```kconfig
#
# STA-only + webserver disabled
# Disables SoftAP, HTTP server, mDNS, and DNS-SD entirely.
# Use with overlay-sta-webserver.conf as the baseline for comparison.
#

# Disable SoftAP driver and supplicant support
CONFIG_NRF70_AP_MODE=n
CONFIG_WIFI_NM_WPA_SUPPLICANT_AP=n

# Disable SoftAP-only networking (DHCP server, static gateway IP)
CONFIG_NET_DHCPV4_SERVER=n
CONFIG_NET_CONFIG_SETTINGS=n

# Default to STA mode on first boot
CONFIG_ZEGO_WIFI_DEFAULT_MODE_SOFTAP=n
CONFIG_ZEGO_WIFI_DEFAULT_MODE_STA=y

# Disable webserver module (gates webserver.c compilation)
CONFIG_WEBSERVER_MODULE=n

# Disable Zephyr HTTP stack
CONFIG_HTTP_SERVER=n
CONFIG_HTTP_PARSER=n
CONFIG_HTTP_PARSER_URL=n

# Disable mDNS / DNS-SD (was only used by the webserver)
CONFIG_MDNS_RESPONDER=n
CONFIG_DNS_SD=n
CONFIG_MDNS_RESPONDER_DNS_SD=n
```

## overlay-sta-webserver.conf
```kconfig
#
# STA-only + webserver enabled
# Disables SoftAP compile-time capability; keeps HTTP server and mDNS.
#

# Disable SoftAP driver and supplicant support
CONFIG_NRF70_AP_MODE=n
CONFIG_WIFI_NM_WPA_SUPPLICANT_AP=n

# Disable SoftAP-only networking (DHCP server, static gateway IP)
CONFIG_NET_DHCPV4_SERVER=n
CONFIG_NET_CONFIG_SETTINGS=n

# Default to STA mode on first boot
CONFIG_ZEGO_WIFI_DEFAULT_MODE_SOFTAP=n
CONFIG_ZEGO_WIFI_DEFAULT_MODE_STA=y

# Webserver and HTTP stack remain enabled (default from prj.conf)
```

## boards/nrf54lm20dk_nrf54lm20a_cpuapp.conf
```kconfig
# ============================================================================
# nRF54LM20DK: 3 user buttons (BUTTON0/1/2), 4 LEDs
# ============================================================================
CONFIG_ZEGO_BUTTON_NUM_BUTTONS=3
CONFIG_ZEGO_BUTTON_BACKEND_DK=y
CONFIG_ZEGO_LED_NUM_LEDS=4
CONFIG_ZEGO_LED_BACKEND_DK=y

# ============================================================================
# nRF54LM20DK: BLE provisioning support
# ============================================================================
CONFIG_ZEGO_WIFI_BLE_PROV=y
CONFIG_ZEGO_WIFI_BLE_PROV_LOG_LEVEL_INF=y
CONFIG_BT_WIFI_PROV_LOG_LEVEL_INF=y
# BT RX WQ needs extra stack for wifi_prov indication/notification callbacks
# Watermark Bytes 20072/0.9=22302
CONFIG_BT_RX_STACK_SIZE=22302
# Watermark Bytes 1984/0.9=2230
CONFIG_BT_LONG_WQ_STACK_SIZE=2230
# nRF54LM20DK uses NRF_SECURITY which auto-enables MBEDTLS_ENABLE_HEAP with
# a default size of only 512 bytes.  PBKDF2-SHA1 (WPA2-PSK key derivation)
# needs heap for its MD context allocations.  32 KB is sufficient and fits
# in available RAM (template uses 86880 but webdash has less headroom).
CONFIG_MBEDTLS_ENABLE_HEAP=y
CONFIG_MBEDTLS_HEAP_SIZE=32768

# ============================================================================
# LOGGING
# ============================================================================

# ============================================================================
# DEBUGGING
# ============================================================================
# NET_SHELL cost: +49.8 KB Flash / +1.4 KB RAM (measured Jun 17 2026)
# Enable only when debugging with net iface / net sockets / net ping / etc.
#CONFIG_NET_SHELL=y
# OBJ_CORE cost: +12.7 KB Flash / +11.8 KB RAM (measured Jun 17 2026, on top of NET_SHELL)
# Enables socket Creator/Name/Lifetime columns in 'net sockets'
#CONFIG_OBJ_CORE=y
#CONFIG_NET_SOCKETS_OBJ_CORE=y

# ============================================================================
# Memory / Stack sizes — nRF54LM20DK measurements
# All values measured on nRF54LM20DK using CONFIG_THREAD_ANALYZER.
# Sizing rule: max_hwm / 0.9 (10 % headroom). Heap: max_hwm / 0.8 (20 % headroom).
# Override prj.conf values which were measured on nRF54LM20DK + nRF7002EB2.
# ============================================================================
# Watermark Bytes 8312/0.9=9235
CONFIG_WIFI_NM_WPA_SUPPLICANT_THREAD_STACK_SIZE=9235
# Watermark Bytes 3600/0.9=4000
CONFIG_WIFI_NM_WPA_SUPPLICANT_WQ_STACK_SIZE=4000
# Watermark Bytes 4560/0.9=5066
CONFIG_SYSTEM_WORKQUEUE_STACK_SIZE=5066
# Watermark Bytes 1512/0.9=1680
CONFIG_NRF70_BH_WQ_STACK_SIZE=4096
# Watermark Bytes 792/0.9=880
CONFIG_NRF70_IRQ_WQ_STACK_SIZE=880
# Watermark Bytes 88248/0.8=110310
CONFIG_HEAP_MEM_POOL_SIZE=110310
```

## boards/nrf7002dk_nrf5340_cpuapp.conf
```kconfig
# nRF7002DK: 2 user buttons (SW0 = Button 1, SW1 = Button 2), 2 LEDs
CONFIG_ZEGO_BUTTON_NUM_BUTTONS=2
CONFIG_ZEGO_BUTTON_BACKEND_DK=y
CONFIG_ZEGO_LED_NUM_LEDS=2
CONFIG_ZEGO_LED_BACKEND_DK=y

# BLE provisioning does not fit on nRF7002DK (nRF5340, 1MB flash).
# The BLE host stack adds ~97KB; only ~23KB is available after the HTTP
# server and web resources.  BLE prov is available on nRF54LM20DK (2MB flash).
CONFIG_ZEGO_WIFI_BLE_PROV=n

# ============================================================================
# Silence the v3.3.0 Kconfig warning:
#   "MBEDTLS_PSA_CRYPTO_EXTERNAL_RNG_ALLOW_NON_CSPRNG was assigned the value
#    'y' but got the value 'n'"
# The nrf7002dk_nrf5340_cpuapp_defconfig sets this symbol to 'y'.
# NRF_SECURITY selects DISABLE_MBEDTLS_BUILTIN and sets
# MBEDTLS_CFG_FILE="nrf-config.h", making the Kconfig.mbedtls menu
# (depends on MBEDTLS_BUILTIN && MBEDTLS_CFG_FILE="config-mbedtls.h")
# invisible.  The dependency is therefore unmet.  Explicitly clearing the
# symbol here overrides the defconfig assignment so the assigned value ('n')
# matches the evaluated value ('n').
#
# A related warning ("The choice symbol MBEDTLS_PSA_CRYPTO_EXTERNAL_RNG was
# selected (set =y) but no symbol ended up as the choice selection") also
# originates from the board defconfig and cannot be silenced at the app
# level: kconfiglib does not honour "# CONFIG_CHOICE_SYMBOL is not set" for
# choice symbols, so the defconfig's choice assignment persists.  This is a
# known upstream issue (NRF_SECURITY overrides the choice via CMake, but the
# Kconfig layer is left inconsistent).  The warning is harmless; nrf_security
# always provides its own RNG implementation regardless of this choice.
# ============================================================================
# CONFIG_MBEDTLS_PSA_CRYPTO_EXTERNAL_RNG_ALLOW_NON_CSPRNG is not set
```

## src/main.c
```c
/*
 * Copyright (c) 2026 Nordic Semiconductor ASA
 * SPDX-License-Identifier: LicenseRef-Nordic-5-Clause
 */

#include <ux.h>

int main(void)
{
	zego_ux_print_banner();
	return 0;
}
```
